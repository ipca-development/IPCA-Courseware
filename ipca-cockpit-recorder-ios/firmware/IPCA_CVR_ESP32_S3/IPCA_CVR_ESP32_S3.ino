#include <Adafruit_GFX.h>
#include <Adafruit_GC9A01A.h>
#include <SPI.h>
#include <Wire.h>
#include <Adafruit_BNO08x.h>
#include <pgmspace.h>
#include <math.h>
#include <BLEDevice.h>
#include <BLEServer.h>
#include <BLEUtils.h>
#include <BLE2902.h>
#include "ipca_fdm_splash.h"

// =======================================================
// IPCA CVR 1.0 + BNO085 AHRS
// Splash screen: 5 sec
// Status screen remains visible after splash.
// BLE AHRS notifications continue; detailed AHRS values are shown on the iPad.
// BLE AHRS notifications for iPad test app.
// =======================================================

#define TFT_RST   4
#define TFT_CS    5
#define TFT_DC    6
#define TFT_MOSI  7
#define TFT_SCK   15

#define BNO_SDA   8
#define BNO_SCL   9

#define SCREEN_STATUS 0
#define SCREEN_AHRS   1

#define SPLASH_SCREEN_MS 5000
#define AHRS_SETUP_RETRY_MS 5000

#define BLE_DEVICE_NAME "IPCA-CVR"
#define BLE_SERVICE_UUID "7b7f1000-9a7b-4f6a-9f0c-6c9c1f8b0001"
#define BLE_AHRS_CHARACTERISTIC_UUID "7b7f1001-9a7b-4f6a-9f0c-6c9c1f8b0001"
#define BLE_STATUS_CHARACTERISTIC_UUID "7b7f1002-9a7b-4f6a-9f0c-6c9c1f8b0001"

Adafruit_GC9A01A tft(TFT_CS, TFT_DC, TFT_MOSI, TFT_SCK, TFT_RST);
Adafruit_BNO08x bno08x(-1);
sh2_SensorValue_t sensorValue;

#define IPCA_BLUE   0x020F
#define WHITE       GC9A01A_WHITE
#define BLACK       GC9A01A_BLACK
#define GREEN       GC9A01A_GREEN
#define YELLOW      GC9A01A_YELLOW
#define RED         GC9A01A_RED

bool ipadReady = false;
bool audioReady = false;
bool gpsReady = false;
bool ahrsReady = false;
bool recording = false;
bool recordingPaused = false;
bool bleCentralConnected = false;
int audioLevelPct = 0;
int uploadState = 0;       // 0 wait, 1 busy, 2 ok, 3 fail
int transcriptionState = 0; // 0 wait, 1 busy, 2 ok, 3 fail

String inputLine = "";

int currentScreen = SCREEN_STATUS;
unsigned long screenStartedAt = 0;
unsigned long lastAHRSPrint = 0;
unsigned long lastAHRSValueDraw = 0;
bool screenDirty = true;
bool statusDynamicDirty = true;
bool ahrsFooterDirty = true;

float rollDeg = 0;
float pitchDeg = 0;
float yawDeg = 0;
float slipG = 0;
float quatW = 1;
float quatX = 0;
float quatY = 0;
float quatZ = 0;

float accX = 0;
float accY = 0;
float accZ = 0;
float accTotal = 0;
float gravityX = 0;
float gravityY = 0;
float gravityZ = 0;

float magX = 0;
float magY = 0;
float magZ = 0;
float magHeadingDeg = 0;
uint8_t rotationVectorAccuracy = 0;
uint8_t magneticFieldAccuracy = 0;
uint8_t lastHeadingQualityCode = 255;

// Mounting/reference offset: with the current board orientation, fused yaw
// reads 270 when the AHRS box is physically aligned with true north.
#define HEADING_MOUNT_OFFSET_DEG 90.0f

BLEServer *bleServer = nullptr;
BLECharacteristic *ahrsCharacteristic = nullptr;
BLECharacteristic *statusCharacteristic = nullptr;

#define LOGO_W 210
#define LOGO_H 210

// =======================================================
// PASTE YOUR FULL BITMAP HERE
//
const unsigned char ipca_logo_bitmap[] PROGMEM = {
  0x00, 0x00, 0x00, 0x00, 0x00, 0x00, 0x00, 0x00, 0x00, 0x00, 0x00, 0x00, 0x00, 0x00, 0x00, 0x00,
  0x00, 0x00, 0x00, 0x00, 0x00, 0x00, 0x00, 0x00, 0x00, 0x00, 0x00, 0x00, 0x00, 0x00, 0x00, 0x00,
  0x00, 0x00, 0x00, 0x00, 0x00, 0x00, 0x00, 0x00, 0x00, 0x00, 0x00, 0x00, 0x00, 0x00, 0x00, 0x00,
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  0x00, 0x00, 0x00, 0x00, 0x00, 0x00
};
//
// =======================================================


void handleCommand(String cmd);

class IPCABLEServerCallbacks : public BLEServerCallbacks {
  void onConnect(BLEServer *server) override {
    bleCentralConnected = true;
    ipadReady = true;
    statusDynamicDirty = true;
  }

  void onDisconnect(BLEServer *server) override {
    bleCentralConnected = false;
    ipadReady = false;
    statusDynamicDirty = true;
    server->getAdvertising()->start();
  }
};

class IPCAStatusCallbacks : public BLECharacteristicCallbacks {
  void onWrite(BLECharacteristic *characteristic) override {
    String cmd = characteristic->getValue().c_str();
    if (cmd.length() > 0) {
      handleCommand(cmd);
    }
  }
};

String buildAHRSLine() {
  char line[448];
  snprintf(
    line,
    sizeof(line),
    "AHRS,QW=%.5f,QX=%.5f,QY=%.5f,QZ=%.5f,ROLL=%.1f,PITCH=%.1f,YAW=%.1f,FUSEDHDG=%.1f,SLIP=%.3f,ACC=%.2f,ACCX=%.2f,ACCY=%.2f,ACCZ=%.2f,LINX=%.2f,LINY=%.2f,LINZ=%.2f,GRAVX=%.2f,GRAVY=%.2f,GRAVZ=%.2f,MAGHDG=%.1f,RVACC=%u,MAGACC=%u,MAGX=%.1f,MAGY=%.1f,MAGZ=%.1f,HDGQ=%u",
    quatW,
    quatX,
    quatY,
    quatZ,
    rollDeg,
    pitchDeg,
    yawDeg,
    yawDeg,
    slipG,
    accTotal,
    accX,
    accY,
    accZ,
    accX,
    accY,
    accZ,
    gravityX,
    gravityY,
    gravityZ,
    magHeadingDeg,
    rotationVectorAccuracy,
    magneticFieldAccuracy,
    magX,
    magY,
    magZ,
    headingQualityCode()
  );
  return String(line);
}

uint8_t headingQualityCode() {
  if (!ahrsReady) return 0;
  if (rotationVectorAccuracy >= 2 && magneticFieldAccuracy >= 2) return 2;
  if (rotationVectorAccuracy >= 1 || magneticFieldAccuracy >= 1) return 1;
  return 0;
}

const char *headingQualityLabel() {
  uint8_t quality = headingQualityCode();
  if (quality >= 2) return "FUSED OK";
  if (quality == 1) return "FUSED LOW";
  return "FUSED BAD";
}

void notifyAHRSLine(const String &line) {
  if (!bleCentralConnected || ahrsCharacteristic == nullptr) return;
  ahrsCharacteristic->setValue((uint8_t *)line.c_str(), line.length());
  ahrsCharacteristic->notify();
}

void setupBLE() {
  BLEDevice::init(BLE_DEVICE_NAME);
  BLEDevice::setMTU(517);

  bleServer = BLEDevice::createServer();
  bleServer->setCallbacks(new IPCABLEServerCallbacks());

  BLEService *service = bleServer->createService(BLE_SERVICE_UUID);
  ahrsCharacteristic = service->createCharacteristic(
    BLE_AHRS_CHARACTERISTIC_UUID,
    BLECharacteristic::PROPERTY_READ | BLECharacteristic::PROPERTY_NOTIFY
  );
  ahrsCharacteristic->addDescriptor(new BLE2902());
  ahrsCharacteristic->setValue(buildAHRSLine().c_str());

  statusCharacteristic = service->createCharacteristic(
    BLE_STATUS_CHARACTERISTIC_UUID,
    BLECharacteristic::PROPERTY_READ | BLECharacteristic::PROPERTY_WRITE | BLECharacteristic::PROPERTY_WRITE_NR
  );
  statusCharacteristic->setCallbacks(new IPCAStatusCallbacks());
  statusCharacteristic->setValue("READY");

  service->start();

  BLEAdvertising *advertising = BLEDevice::getAdvertising();
  advertising->addServiceUUID(BLE_SERVICE_UUID);
  advertising->setScanResponse(true);
  advertising->setMinPreferred(0x06);
  advertising->setMinPreferred(0x12);
  BLEDevice::startAdvertising();

  Serial.println("BLE IPCA-CVR advertising");
}

float normalizeDegrees360(float degrees) {
  while (degrees < 0.0f) degrees += 360.0f;
  while (degrees >= 360.0f) degrees -= 360.0f;
  return degrees;
}

void quatToEuler(float qr, float qi, float qj, float qk) {
  float mathYawDeg = atan2(2.0f * (qi * qj + qk * qr),
                           qi * qi - qj * qj - qk * qk + qr * qr) * 180.0f / PI;
  // BNO quaternion yaw is mathematical-positive; aircraft heading is
  // clockwise-positive. Yawing left should decrease heading, not increase it.
  yawDeg = normalizeDegrees360(HEADING_MOUNT_OFFSET_DEG - mathYawDeg);

  pitchDeg = asin(-2.0f * (qi * qk - qj * qr)) * 180.0f / PI;

  rollDeg = atan2(2.0f * (qj * qk + qi * qr),
                  -qi * qi - qj * qj + qk * qk + qr * qr) * 180.0f / PI;

  // Stable body-frame lateral gravity proxy for the slip/skid ball. This uses
  // fused roll/quaternion attitude, not magnetometer or transient linear accel.
  slipG = sin(rollDeg * PI / 180.0f);
}

void setupAHRS() {
  Wire.begin(BNO_SDA, BNO_SCL);
  delay(250);

  Serial.println("Searching for BNO085...");

  bool found = false;
  unsigned long startedAt = millis();
  while (millis() - startedAt < AHRS_SETUP_RETRY_MS) {
    if (bno08x.begin_I2C(0x4A, &Wire)) {
      Serial.println("BNO085 FOUND at 0x4A");
      found = true;
      break;
    }
    if (bno08x.begin_I2C(0x4B, &Wire)) {
      Serial.println("BNO085 FOUND at 0x4B");
      found = true;
      break;
    }

    Serial.println("BNO085 not ready yet, retrying...");
    delay(250);
  }

  if (!found) {
    Serial.println("BNO085 NOT FOUND at 0x4A or 0x4B");
    ahrsReady = false;
    screenDirty = true;
    statusDynamicDirty = true;
    return;
  }

  if (!bno08x.enableReport(SH2_ROTATION_VECTOR, 10000)) {
    Serial.println("ROTATION VECTOR FAILED");
    ahrsReady = false;
    screenDirty = true;
    statusDynamicDirty = true;
    return;
  }

  bno08x.enableReport(SH2_LINEAR_ACCELERATION, 20000);
  bno08x.enableReport(SH2_GRAVITY, 20000);
  bno08x.enableReport(SH2_MAGNETIC_FIELD_CALIBRATED, 20000);

  ahrsReady = true;
  screenDirty = true;
  statusDynamicDirty = true;
}

void readAHRS() {
  if (!ahrsReady) return;

  if (bno08x.wasReset()) {
    bno08x.enableReport(SH2_ROTATION_VECTOR, 10000);
    bno08x.enableReport(SH2_LINEAR_ACCELERATION, 20000);
    bno08x.enableReport(SH2_GRAVITY, 20000);
    bno08x.enableReport(SH2_MAGNETIC_FIELD_CALIBRATED, 20000);
  }

  while (bno08x.getSensorEvent(&sensorValue)) {
    if (sensorValue.sensorId == SH2_ROTATION_VECTOR) {
      rotationVectorAccuracy = sensorValue.status;
      quatW = sensorValue.un.rotationVector.real;
      quatX = sensorValue.un.rotationVector.i;
      quatY = sensorValue.un.rotationVector.j;
      quatZ = sensorValue.un.rotationVector.k;
      quatToEuler(
        quatW,
        quatX,
        quatY,
        quatZ
      );
      // Do not derive heading from raw MAGX/MAGY. The rotation vector is
      // BNO085-fused and tilt-compensated; raw magnetometer is diagnostic only.
      magHeadingDeg = yawDeg;
    }

    if (sensorValue.sensorId == SH2_LINEAR_ACCELERATION) {
      accX = sensorValue.un.linearAcceleration.x;
      accY = sensorValue.un.linearAcceleration.y;
      accZ = sensorValue.un.linearAcceleration.z;
      accTotal = sqrt(accX * accX + accY * accY + accZ * accZ);
    }

    if (sensorValue.sensorId == SH2_GRAVITY) {
      gravityX = sensorValue.un.gravity.x;
      gravityY = sensorValue.un.gravity.y;
      gravityZ = sensorValue.un.gravity.z;
    }

    if (sensorValue.sensorId == SH2_MAGNETIC_FIELD_CALIBRATED) {
      magneticFieldAccuracy = sensorValue.status;
      magX = sensorValue.un.magneticField.x;
      magY = sensorValue.un.magneticField.y;
      magZ = sensorValue.un.magneticField.z;
    }
  }

  uint8_t currentHeadingQuality = headingQualityCode();
  if (currentHeadingQuality != lastHeadingQualityCode) {
    lastHeadingQualityCode = currentHeadingQuality;
    statusDynamicDirty = true;
  }

  if (millis() - lastAHRSPrint > 250) {
    Serial.print("AHRS,ROLL=");
    Serial.print(rollDeg, 1);
    Serial.print(",PITCH=");
    Serial.print(pitchDeg, 1);
    Serial.print(",YAW=");
    Serial.print(yawDeg, 1);
    Serial.print(",QW=");
    Serial.print(quatW, 5);
    Serial.print(",QX=");
    Serial.print(quatX, 5);
    Serial.print(",QY=");
    Serial.print(quatY, 5);
    Serial.print(",QZ=");
    Serial.print(quatZ, 5);
    Serial.print(",FUSEDHDG=");
    Serial.print(yawDeg, 1);
    Serial.print(",SLIP=");
    Serial.print(slipG, 3);
    Serial.print(",ACC=");
    Serial.print(accTotal, 2);
    Serial.print(",ACCX=");
    Serial.print(accX, 2);
    Serial.print(",ACCY=");
    Serial.print(accY, 2);
    Serial.print(",ACCZ=");
    Serial.print(accZ, 2);
    Serial.print(",LINX=");
    Serial.print(accX, 2);
    Serial.print(",LINY=");
    Serial.print(accY, 2);
    Serial.print(",LINZ=");
    Serial.print(accZ, 2);
    Serial.print(",GRAVX=");
    Serial.print(gravityX, 2);
    Serial.print(",GRAVY=");
    Serial.print(gravityY, 2);
    Serial.print(",GRAVZ=");
    Serial.print(gravityZ, 2);
    Serial.print(",MAGHDG=");
    Serial.print(magHeadingDeg, 1);
    Serial.print(",RVACC=");
    Serial.print(rotationVectorAccuracy);
    Serial.print(",MAGACC=");
    Serial.print(magneticFieldAccuracy);
    Serial.print(",MAGX=");
    Serial.print(magX, 1);
    Serial.print(",MAGY=");
    Serial.print(magY, 1);
    Serial.print(",MAGZ=");
    Serial.print(magZ, 1);
    Serial.print(",HDGQ=");
    Serial.println(headingQualityCode());

    notifyAHRSLine(buildAHRSLine());

    lastAHRSPrint = millis();
  }
}

void drawSplashScreen() {
  tft.drawRGBBitmap(0, 0, ipca_fdm_splash, IPCA_FDM_SPLASH_W, IPCA_FDM_SPLASH_H);
}

void drawStatusLine(int x, int y, const char *label, bool ok, const char *value) {
  tft.fillRect(x - 8, y - 2, 184, 16, BLACK);
  tft.fillCircle(x, y + 6, 5, ok ? GREEN : YELLOW);
  tft.setTextSize(1);
  tft.setTextColor(WHITE);
  tft.setCursor(x + 12, y);
  tft.print(label);
  tft.setCursor(x + 58, y);
  tft.setTextColor(ok ? GREEN : YELLOW);
  tft.print(value);
}

void drawStateLine(int x, int y, const char *label, int state) {
  uint16_t color = YELLOW;
  const char *value = "WAIT";
  if (state == 1) {
    color = YELLOW;
    value = "BUSY";
  } else if (state == 2) {
    color = GREEN;
    value = "OK";
  } else if (state == 3) {
    color = RED;
    value = "FAIL";
  }

  tft.fillRect(x - 8, y - 2, 78, 16, BLACK);
  tft.fillCircle(x, y + 6, 5, color);
  tft.setTextSize(1);
  tft.setTextColor(WHITE);
  tft.setCursor(x + 12, y);
  tft.print(label);
  tft.setTextColor(color);
  tft.setCursor(x + 34, y);
  tft.print(value);
}

void drawAudioStatus(int x, int y) {
  int barW = 78;
  int fillW = map(audioLevelPct, 0, 100, 0, barW);
  tft.fillRect(x - 8, y - 2, 188, 16, BLACK);
  tft.fillCircle(x, y + 6, 5, audioReady ? GREEN : YELLOW);
  tft.setTextSize(1);
  tft.setTextColor(WHITE);
  tft.setCursor(x + 12, y);
  tft.print("Audio");
  tft.drawRect(x + 58, y, barW, 10, WHITE);
  tft.fillRect(x + 59, y + 1, max(0, fillW - 2), 8, audioReady ? GREEN : YELLOW);
  tft.setCursor(x + 142, y);
  tft.setTextColor(audioReady ? GREEN : YELLOW);
  tft.print(audioLevelPct);
  tft.print("%");
}

void drawStatusDynamicFields() {
  drawStatusLine(28, 86, "iPad", ipadReady, ipadReady ? "BLE OK" : "WAIT");
  drawStatusLine(28, 106, "AHRS", ahrsReady && headingQualityCode() >= 2, ahrsReady ? headingQualityLabel() : "WAIT");
  drawStatusLine(28, 126, "GPS", gpsReady, gpsReady ? "READY" : "NO FIX");
  drawAudioStatus(28, 149);
  drawStateLine(28, 174, "UP", uploadState);
  drawStateLine(112, 174, "TX", transcriptionState);

  tft.fillRect(36, 199, 168, 25, BLACK);
  tft.setTextSize(2);
  if (recordingPaused) {
    tft.fillCircle(54, 212, 7, YELLOW);
    tft.setTextColor(YELLOW);
    tft.setCursor(74, 205);
    tft.println("PAUSED");
  } else if (recording) {
    tft.fillCircle(72, 212, 7, RED);
    tft.setTextColor(RED);
    tft.setCursor(92, 205);
    tft.println("REC");
  } else {
    tft.fillCircle(50, 212, 7, YELLOW);
    tft.setTextColor(YELLOW);
    tft.setCursor(70, 205);
    tft.println("STANDBY");
  }
}

void drawRecordingFooter() {
  tft.fillRect(54, 210, 134, 13, BLACK);
  tft.setTextSize(1);
  if (recordingPaused) {
    tft.setTextColor(YELLOW);
    tft.setCursor(92, 215);
    tft.print("PAUSED");
  } else if (recording) {
    tft.setTextColor(RED);
    tft.setCursor(104, 215);
    tft.print("REC");
  } else {
    tft.setTextColor(YELLOW);
    tft.setCursor(88, 215);
    tft.print("STANDBY");
  }
}

void drawStatusScreen() {
  tft.fillScreen(BLACK);

  tft.drawCircle(120, 120, 116, IPCA_BLUE);
  tft.drawCircle(120, 120, 117, IPCA_BLUE);

  tft.setTextColor(WHITE);
  tft.setTextSize(3);
  tft.setCursor(55, 24);
  tft.println("IPCA");

  tft.setTextSize(2);
  tft.setCursor(74, 54);
  tft.println("STATUS");

  drawStatusDynamicFields();
}

void drawAHRSScreenFrame() {
  tft.fillScreen(BLACK);

  tft.drawCircle(120, 120, 116, IPCA_BLUE);
  tft.drawCircle(120, 120, 117, IPCA_BLUE);

  tft.setTextColor(WHITE);
  tft.setTextSize(3);
  tft.setCursor(55, 18);
  tft.println("IPCA");

  tft.setTextSize(2);
  tft.setCursor(55, 52);
  tft.println("AHRS LIVE");

  tft.setTextSize(2);
  tft.setTextColor(WHITE);

  tft.setCursor(28, 84);
  tft.print("ROLL");

  tft.setCursor(28, 108);
  tft.print("PITCH");

  tft.setCursor(28, 132);
  tft.print("YAW");

  tft.setCursor(28, 156);
  tft.print("ACC");

  tft.setCursor(28, 180);
  tft.print("MAG");

  drawRecordingFooter();
}

void clearValueArea(int y) {
  tft.fillRect(105, y - 2, 92, 18, BLACK);
}

void printValue(float value, int y, int decimals, const char *suffix) {
  clearValueArea(y);
  tft.setTextSize(2);
  tft.setTextColor(GREEN);
  tft.setCursor(105, y);
  tft.print(value, decimals);
  tft.print(suffix);
}

void updateAHRSScreenValues() {
  printValue(rollDeg, 84, 1, "");
  printValue(pitchDeg, 108, 1, "");
  printValue(yawDeg, 132, 1, "");
  printValue(accTotal, 156, 2, "");
  printValue(magHeadingDeg, 180, 0, "");
}

void switchToScreen(int newScreen) {
  currentScreen = newScreen;
  screenStartedAt = millis();
  screenDirty = true;
}

void handleCommand(String cmd) {
  cmd.trim();
  cmd.toUpperCase();

  bool fullRedraw = false;
  bool statusUpdate = false;
  bool footerUpdate = false;

  if (cmd == "IPAD=1") {
    ipadReady = true;
    statusUpdate = true;
  } else if (cmd == "IPAD=0") {
    ipadReady = false;
    statusUpdate = true;
  } else if (cmd == "AUDIO=1") {
    audioReady = true;
    statusUpdate = true;
  } else if (cmd == "AUDIO=0") {
    audioReady = false;
    audioLevelPct = 0;
    statusUpdate = true;
  } else if (cmd.startsWith("AUDIOLEVEL=")) {
    audioLevelPct = constrain(cmd.substring(11).toInt(), 0, 100);
    audioReady = audioLevelPct > 0;
    statusUpdate = true;
  } else if (cmd == "GPS=1") {
    gpsReady = true;
    statusUpdate = true;
  } else if (cmd == "GPS=0") {
    gpsReady = false;
    statusUpdate = true;
  } else if (cmd == "REC=1") {
    recording = true;
    recordingPaused = false;
    statusUpdate = true;
    footerUpdate = true;
  } else if (cmd == "REC=0") {
    recording = false;
    recordingPaused = false;
    statusUpdate = true;
    footerUpdate = true;
  } else if (cmd == "REC=PAUSE") {
    recording = true;
    recordingPaused = true;
    statusUpdate = true;
    footerUpdate = true;
  } else if (cmd == "UPLOAD=WAIT") {
    uploadState = 0;
    statusUpdate = true;
  } else if (cmd == "UPLOAD=BUSY") {
    uploadState = 1;
    statusUpdate = true;
  } else if (cmd == "UPLOAD=OK") {
    uploadState = 2;
    statusUpdate = true;
  } else if (cmd == "UPLOAD=FAIL") {
    uploadState = 3;
    statusUpdate = true;
  } else if (cmd == "TX=WAIT") {
    transcriptionState = 0;
    statusUpdate = true;
  } else if (cmd == "TX=BUSY") {
    transcriptionState = 1;
    statusUpdate = true;
  } else if (cmd == "TX=OK") {
    transcriptionState = 2;
    statusUpdate = true;
  } else if (cmd == "TX=FAIL") {
    transcriptionState = 3;
    statusUpdate = true;
  } else if (cmd == "BOOT") {
    drawSplashScreen();
    delay(SPLASH_SCREEN_MS);
    fullRedraw = true;
  } else if (cmd == "SCREEN=0") {
    switchToScreen(SCREEN_STATUS);
    fullRedraw = false;
  } else if (cmd == "SCREEN=1") {
    switchToScreen(SCREEN_STATUS);
    fullRedraw = false;
  } else if (cmd == "ALL=1") {
    ipadReady = true;
    audioReady = true;
    gpsReady = true;
    recording = true;
    statusUpdate = true;
    footerUpdate = true;
  } else if (cmd == "ALL=0") {
    ipadReady = false;
    audioReady = false;
    gpsReady = false;
    recording = false;
    recordingPaused = false;
    audioLevelPct = 0;
    uploadState = 0;
    transcriptionState = 0;
    statusUpdate = true;
    footerUpdate = true;
  }

  if (fullRedraw) {
    screenDirty = true;
  }
  if (statusUpdate) {
    statusDynamicDirty = true;
  }
  if (footerUpdate) {
    ahrsFooterDirty = true;
  }
}

void readSerialCommands() {
  while (Serial.available() > 0) {
    char c = Serial.read();

    if (c == '\n' || c == '\r') {
      if (inputLine.length() > 0) {
        handleCommand(inputLine);
        inputLine = "";
      }
    } else {
      inputLine += c;
      if (inputLine.length() > 64) {
        inputLine = "";
      }
    }
  }
}

void setup() {
  delay(1000);

  Serial.begin(115200);
  delay(500);

  setupBLE();

  tft.begin();
  tft.setRotation(0);

  unsigned long splashStartedAt = millis();
  drawSplashScreen();

  setupAHRS();

  while (millis() - splashStartedAt < SPLASH_SCREEN_MS) {
    delay(10);
  }

  switchToScreen(SCREEN_STATUS);
}

void loop() {
  readSerialCommands();
  readAHRS();

  if (currentScreen == SCREEN_STATUS) {
    if (screenDirty) {
      drawStatusScreen();
      screenDirty = false;
      statusDynamicDirty = false;
    } else if (statusDynamicDirty) {
      drawStatusDynamicFields();
      statusDynamicDirty = false;
    }
  }
}