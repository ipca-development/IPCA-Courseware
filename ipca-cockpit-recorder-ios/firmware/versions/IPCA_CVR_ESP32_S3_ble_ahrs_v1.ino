#include <Adafruit_GFX.h>
#include <Adafruit_GC9A01A.h>
#include <SPI.h>
#include <Wire.h>
#include <Adafruit_BNO08x.h>
#include <pgmspace.h>
#include <math.h>
#include <BLEDevice.h>
#include <BLEServer.h>
#include <BLEUtils.h>
#include <BLE2902.h>

// =======================================================
// IPCA CVR 1.0 + BNO085 AHRS
// Status screen: 5 sec
// AHRS screen: 10 sec
// AHRS screen frame does NOT refresh; only values update.
// BLE AHRS notifications for iPad test app.
// =======================================================

#define TFT_RST   4
#define TFT_CS    5
#define TFT_DC    6
#define TFT_MOSI  7
#define TFT_SCK   15

#define BNO_SDA   8
#define BNO_SCL   9

#define SCREEN_STATUS 0
#define SCREEN_AHRS   1

#define STATUS_SCREEN_MS 5000
#define AHRS_SCREEN_MS   10000
#define AHRS_VALUE_REFRESH_MS 250

#define BLE_DEVICE_NAME "IPCA-CVR"
#define BLE_SERVICE_UUID "7b7f1000-9a7b-4f6a-9f0c-6c9c1f8b0001"
#define BLE_AHRS_CHARACTERISTIC_UUID "7b7f1001-9a7b-4f6a-9f0c-6c9c1f8b0001"

Adafruit_GC9A01A tft(TFT_CS, TFT_DC, TFT_MOSI, TFT_SCK, TFT_RST);
Adafruit_BNO08x bno08x(-1);
sh2_SensorValue_t sensorValue;

#define IPCA_BLUE   0x020F
#define WHITE       GC9A01A_WHITE
#define BLACK       GC9A01A_BLACK
#define GREEN       GC9A01A_GREEN
#define YELLOW      GC9A01A_YELLOW
#define RED         GC9A01A_RED

bool ipadReady = false;
bool audioReady = false;
bool ahrsReady = false;
bool recording = false;
bool bleCentralConnected = false;

String inputLine = "";

int currentScreen = SCREEN_STATUS;
unsigned long screenStartedAt = 0;
unsigned long lastAHRSPrint = 0;
unsigned long lastAHRSValueDraw = 0;
bool screenDirty = true;

float rollDeg = 0;
float pitchDeg = 0;
float yawDeg = 0;

float accX = 0;
float accY = 0;
float accZ = 0;
float accTotal = 0;

float magX = 0;
float magY = 0;
float magZ = 0;
float magHeadingDeg = 0;

BLEServer *bleServer = nullptr;
BLECharacteristic *ahrsCharacteristic = nullptr;

#define LOGO_W 210
#define LOGO_H 210

// =======================================================
// PASTE YOUR FULL BITMAP HERE
//
const unsigned char ipca_logo_bitmap[] PROGMEM = {
  0x00, 0x00, 0x00, 0x00, 0x00, 0x00, 0x00, 0x00, 0x00, 0x00, 0x00, 0x00, 0x00, 0x00, 0x00, 0x00,
  0x00, 0x00, 0x00, 0x00, 0x00, 0x00, 0x00, 0x00, 0x00, 0x00, 0x00, 0x00, 0x00, 0x00, 0x00, 0x00,
  0x00, 0x00, 0x00, 0x00, 0x00, 0x00, 0x00, 0x00, 0x00, 0x00, 0x00, 0x00, 0x00, 0x00, 0x00, 0x00,
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  0x00, 0x00, 0x00, 0x00, 0x00, 0x00
};
//
// =======================================================


class IPCABLEServerCallbacks : public BLEServerCallbacks {
  void onConnect(BLEServer *server) override {
    bleCentralConnected = true;
    ipadReady = true;
    screenDirty = true;
  }

  void onDisconnect(BLEServer *server) override {
    bleCentralConnected = false;
    ipadReady = false;
    screenDirty = true;
    server->getAdvertising()->start();
  }
};

String buildAHRSLine() {
  char line[96];
  snprintf(
    line,
    sizeof(line),
    "AHRS,ROLL=%.1f,PITCH=%.1f,YAW=%.1f,ACC=%.2f,MAGHDG=%.1f",
    rollDeg,
    pitchDeg,
    yawDeg,
    accTotal,
    magHeadingDeg
  );
  return String(line);
}

void notifyAHRSLine(const String &line) {
  if (!bleCentralConnected || ahrsCharacteristic == nullptr) return;
  ahrsCharacteristic->setValue((uint8_t *)line.c_str(), line.length());
  ahrsCharacteristic->notify();
}

void setupBLE() {
  BLEDevice::init(BLE_DEVICE_NAME);

  bleServer = BLEDevice::createServer();
  bleServer->setCallbacks(new IPCABLEServerCallbacks());

  BLEService *service = bleServer->createService(BLE_SERVICE_UUID);
  ahrsCharacteristic = service->createCharacteristic(
    BLE_AHRS_CHARACTERISTIC_UUID,
    BLECharacteristic::PROPERTY_READ | BLECharacteristic::PROPERTY_NOTIFY
  );
  ahrsCharacteristic->addDescriptor(new BLE2902());
  ahrsCharacteristic->setValue(buildAHRSLine().c_str());

  service->start();

  BLEAdvertising *advertising = BLEDevice::getAdvertising();
  advertising->addServiceUUID(BLE_SERVICE_UUID);
  advertising->setScanResponse(true);
  advertising->setMinPreferred(0x06);
  advertising->setMinPreferred(0x12);
  BLEDevice::startAdvertising();

  Serial.println("BLE IPCA-CVR advertising");
}

void quatToEuler(float qr, float qi, float qj, float qk) {
  yawDeg = atan2(2.0f * (qi * qj + qk * qr),
                 qi * qi - qj * qj - qk * qk + qr * qr) * 180.0f / PI;

  pitchDeg = asin(-2.0f * (qi * qk - qj * qr)) * 180.0f / PI;

  rollDeg = atan2(2.0f * (qj * qk + qi * qr),
                  -qi * qi - qj * qj + qk * qk + qr * qr) * 180.0f / PI;
}

void setupAHRS() {
  Wire.begin(BNO_SDA, BNO_SCL);
  delay(250);

  Serial.println("Searching for BNO085...");

  if (bno08x.begin_I2C(0x4A, &Wire)) {
    Serial.println("BNO085 FOUND at 0x4A");
  } else if (bno08x.begin_I2C(0x4B, &Wire)) {
    Serial.println("BNO085 FOUND at 0x4B");
  } else {
    Serial.println("BNO085 NOT FOUND at 0x4A or 0x4B");
    ahrsReady = false;
    screenDirty = true;
    return;
  }

  if (!bno08x.enableReport(SH2_ROTATION_VECTOR, 10000)) {
    Serial.println("ROTATION VECTOR FAILED");
    ahrsReady = false;
    screenDirty = true;
    return;
  }

  bno08x.enableReport(SH2_LINEAR_ACCELERATION, 20000);
  bno08x.enableReport(SH2_MAGNETIC_FIELD_CALIBRATED, 20000);

  ahrsReady = true;
  screenDirty = true;
}

void readAHRS() {
  if (!ahrsReady) return;

  if (bno08x.wasReset()) {
    bno08x.enableReport(SH2_ROTATION_VECTOR, 10000);
    bno08x.enableReport(SH2_LINEAR_ACCELERATION, 20000);
    bno08x.enableReport(SH2_MAGNETIC_FIELD_CALIBRATED, 20000);
  }

  while (bno08x.getSensorEvent(&sensorValue)) {
    if (sensorValue.sensorId == SH2_ROTATION_VECTOR) {
      quatToEuler(
        sensorValue.un.rotationVector.real,
        sensorValue.un.rotationVector.i,
        sensorValue.un.rotationVector.j,
        sensorValue.un.rotationVector.k
      );
    }

    if (sensorValue.sensorId == SH2_LINEAR_ACCELERATION) {
      accX = sensorValue.un.linearAcceleration.x;
      accY = sensorValue.un.linearAcceleration.y;
      accZ = sensorValue.un.linearAcceleration.z;
      accTotal = sqrt(accX * accX + accY * accY + accZ * accZ);
    }

    if (sensorValue.sensorId == SH2_MAGNETIC_FIELD_CALIBRATED) {
      magX = sensorValue.un.magneticField.x;
      magY = sensorValue.un.magneticField.y;
      magZ = sensorValue.un.magneticField.z;

      magHeadingDeg = atan2(magY, magX) * 180.0f / PI;
      if (magHeadingDeg < 0) magHeadingDeg += 360.0f;
    }
  }

  if (millis() - lastAHRSPrint > 250) {
    Serial.print("AHRS,ROLL=");
    Serial.print(rollDeg, 1);
    Serial.print(",PITCH=");
    Serial.print(pitchDeg, 1);
    Serial.print(",YAW=");
    Serial.print(yawDeg, 1);
    Serial.print(",ACC=");
    Serial.print(accTotal, 2);
    Serial.print(",MAGHDG=");
    Serial.println(magHeadingDeg, 1);

    notifyAHRSLine(buildAHRSLine());

    lastAHRSPrint = millis();
  }
}

void drawSplashScreen() {
  tft.fillScreen(IPCA_BLUE);

  int logoX = (240 - LOGO_W) / 2;
  int logoY = 24;
  tft.drawBitmap(logoX, logoY, ipca_logo_bitmap, LOGO_W, LOGO_H, WHITE);

  tft.drawLine(42, 133, 198, 133, WHITE);

  tft.setTextColor(WHITE);
  tft.setTextSize(5);
  tft.setCursor(50, 150);
  tft.println("CVR");

  tft.setTextSize(3);
  tft.setCursor(93, 205);
  tft.println("1.0");
}

void drawStatusScreen() {
  tft.fillScreen(BLACK);

  tft.drawCircle(120, 120, 116, IPCA_BLUE);
  tft.drawCircle(120, 120, 117, IPCA_BLUE);

  tft.setTextColor(WHITE);
  tft.setTextSize(3);
  tft.setCursor(55, 24);
  tft.println("IPCA");

  tft.setTextSize(4);
  tft.setCursor(68, 58);
  tft.println("CVR");

  tft.setTextSize(2);

  tft.fillCircle(40, 118, 7, ipadReady ? GREEN : YELLOW);
  tft.setTextColor(WHITE);
  tft.setCursor(58, 111);
  tft.println(ipadReady ? "iPad READY" : "iPad WAIT");

  tft.fillCircle(40, 146, 7, audioReady ? GREEN : YELLOW);
  tft.setCursor(58, 139);
  tft.println(audioReady ? "Audio READY" : "Audio WAIT");

  tft.fillCircle(40, 174, 7, ahrsReady ? GREEN : YELLOW);
  tft.setCursor(58, 167);
  tft.println(ahrsReady ? "AHRS READY" : "AHRS WAIT");

  if (recording) {
    tft.fillCircle(72, 212, 7, RED);
    tft.setTextColor(RED);
    tft.setCursor(92, 205);
    tft.println("REC");
  } else {
    tft.fillCircle(50, 212, 7, YELLOW);
    tft.setTextColor(YELLOW);
    tft.setCursor(70, 205);
    tft.println("STANDBY");
  }
}

void drawAHRSScreenFrame() {
  tft.fillScreen(BLACK);

  tft.drawCircle(120, 120, 116, IPCA_BLUE);
  tft.drawCircle(120, 120, 117, IPCA_BLUE);

  tft.setTextColor(WHITE);
  tft.setTextSize(3);
  tft.setCursor(55, 18);
  tft.println("IPCA");

  tft.setTextSize(2);
  tft.setCursor(55, 52);
  tft.println("AHRS LIVE");

  tft.setTextSize(2);
  tft.setTextColor(WHITE);

  tft.setCursor(28, 84);
  tft.print("ROLL");

  tft.setCursor(28, 108);
  tft.print("PITCH");

  tft.setCursor(28, 132);
  tft.print("YAW");

  tft.setCursor(28, 156);
  tft.print("ACC");

  tft.setCursor(28, 180);
  tft.print("MAG");

  tft.setTextSize(1);
  tft.setTextColor(YELLOW);
  tft.setCursor(67, 215);
  tft.print("BNO085 FUSION");
}

void clearValueArea(int y) {
  tft.fillRect(105, y - 2, 92, 18, BLACK);
}

void printValue(float value, int y, int decimals, const char *suffix) {
  clearValueArea(y);
  tft.setTextSize(2);
  tft.setTextColor(GREEN);
  tft.setCursor(105, y);
  tft.print(value, decimals);
  tft.print(suffix);
}

void updateAHRSScreenValues() {
  printValue(rollDeg, 84, 1, "");
  printValue(pitchDeg, 108, 1, "");
  printValue(yawDeg, 132, 1, "");
  printValue(accTotal, 156, 2, "");
  printValue(magHeadingDeg, 180, 0, "");
}

void switchToScreen(int newScreen) {
  currentScreen = newScreen;
  screenStartedAt = millis();
  screenDirty = true;
}

void handleCommand(String cmd) {
  cmd.trim();
  cmd.toUpperCase();

  if (cmd == "IPAD=1") {
    ipadReady = true;
  } else if (cmd == "IPAD=0") {
    ipadReady = false;
  } else if (cmd == "AUDIO=1") {
    audioReady = true;
  } else if (cmd == "AUDIO=0") {
    audioReady = false;
  } else if (cmd == "REC=1") {
    recording = true;
  } else if (cmd == "REC=0") {
    recording = false;
  } else if (cmd == "BOOT") {
    drawSplashScreen();
    delay(1500);
  } else if (cmd == "SCREEN=0") {
    switchToScreen(SCREEN_STATUS);
  } else if (cmd == "SCREEN=1") {
    switchToScreen(SCREEN_AHRS);
  } else if (cmd == "ALL=1") {
    ipadReady = true;
    audioReady = true;
    recording = true;
  } else if (cmd == "ALL=0") {
    ipadReady = false;
    audioReady = false;
    recording = false;
  }

  screenDirty = true;
}

void readSerialCommands() {
  while (Serial.available() > 0) {
    char c = Serial.read();

    if (c == '\n' || c == '\r') {
      if (inputLine.length() > 0) {
        handleCommand(inputLine);
        inputLine = "";
      }
    } else {
      inputLine += c;
      if (inputLine.length() > 64) {
        inputLine = "";
      }
    }
  }
}

void setup() {
  delay(1000);

  Serial.begin(115200);
  delay(500);

  setupBLE();

  tft.begin();
  tft.setRotation(0);

  drawSplashScreen();

  setupAHRS();

  delay(3000);

  switchToScreen(SCREEN_STATUS);
  drawStatusScreen();
}

void loop() {
  readSerialCommands();
  readAHRS();

  unsigned long now = millis();

  if (currentScreen == SCREEN_STATUS && now - screenStartedAt >= STATUS_SCREEN_MS) {
    switchToScreen(SCREEN_AHRS);
  }

  if (currentScreen == SCREEN_AHRS && now - screenStartedAt >= AHRS_SCREEN_MS) {
    switchToScreen(SCREEN_STATUS);
  }

  if (currentScreen == SCREEN_STATUS) {
    if (screenDirty) {
      drawStatusScreen();
      screenDirty = false;
    }
  }

  if (currentScreen == SCREEN_AHRS) {
    if (screenDirty) {
      drawAHRSScreenFrame();
      updateAHRSScreenValues();
      lastAHRSValueDraw = now;
      screenDirty = false;
    }

    if (now - lastAHRSValueDraw >= AHRS_VALUE_REFRESH_MS) {
      updateAHRSScreenValues();
      lastAHRSValueDraw = now;
    }
  }
}

</user_query>